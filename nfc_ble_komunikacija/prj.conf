## CMakeLists.txt
```
cmake_minimum_required(VERSION 3.20.0)

find_package(Zephyr REQUIRED HINTS $ENV{ZEPHYR_BASE})
project(NONE)

FILE(GLOB app_sources src/*.c)
target_sources(app  PRIVATE ${app_sources})
```

## sample.yaml
```
sample:
  description: NFC and BLE
  name: NFC and BLE
tests:
  sample.nfc.record_text:
    build_only: true
    integration_platforms:
      - nrf52840dk_nrf52840
      - nrf52dk_nrf52832
      - nrf5340dk_nrf5340_cpuapp
      - nrf5340dk_nrf5340_cpuapp_ns
    platform_allow: nrf52840dk_nrf52840 nrf52dk_nrf52832 nrf5340dk_nrf5340_cpuapp
      nrf5340dk_nrf5340_cpuapp_ns
    tags: ci_build
```

## prj.conf
```kconfig
#
# Copyright (c) 2019 Nordic Semiconductor ASA
#
# SPDX-License-Identifier: LicenseRef-Nordic-5-Clause
#
CONFIG_NCS_SAMPLES_DEFAULTS=y

CONFIG_NFC_T4T_NRFXLIB=y
CONFIG_MPU_ALLOW_FLASH_WRITE=y
CONFIG_FLASH=y
CONFIG_FLASH_PAGE_LAYOUT=y
CONFIG_NVS=y

CONFIG_REBOOT=y
CONFIG_FLASH=y
CONFIG_NFC_NDEF=y
CONFIG_NFC_NDEF_MSG=y
CONFIG_NFC_NDEF_RECORD=y
CONFIG_NFC_NDEF_TEXT_RECORD=y
CONFIG_BT_DEVICE_NAME="Nordic_nRF52840"
CONFIG_BT=y

CONFIG_DK_LIBRARY=y

CONFIG_NFC_T2T_NRFXLIB=y


CONFIG_NFC_NDEF_URI_REC=y
CONFIG_NFC_NDEF_URI_MSG=y
CONFIG_CONSOLE=y
CONFIG_CONSOLE_SUBSYS=y
CONFIG_CONSOLE_HANDLER=y
CONFIG_CONSOLE_GETCHAR=y

CONFIG_BT_CTLR_SDC_LLPM=y

CONFIG_BT_DEBUG_LOG=y
CONFIG_BT_SMP=y
CONFIG_BT_PERIPHERAL=y
CONFIG_BT_CENTRAL=y
CONFIG_BT_MAX_CONN=2

CONFIG_BT_SCAN=y
CONFIG_BT_SCAN_FILTER_ENABLE=y
CONFIG_BT_SCAN_UUID_CNT=1

CONFIG_BT_LATENCY=y
CONFIG_BT_LATENCY_CLIENT=y

CONFIG_BT_LL_SOFTDEVICE=y
CONFIG_BT_HCI_VS_EVT_USER=y
CONFIG_HEAP_MEM_POOL_SIZE=2048
CONFIG_BT_GAP_PERIPHERAL_PREF_PARAMS=n
```

## src/main.c
```c
#include <zephyr/sys/reboot.h> 
#include <nfc_t2t_lib.h>
#include <nfc/ndef/msg.h>
#include <nfc/ndef/text_rec.h>
#include <dk_buttons_and_leds.h>
#include <nfc/t4t/ndef_file.h>
#include "ndef_file_m.h"
#include <bluetooth/gatt_dm.h>

#define SLEEP_TIME          2
#define MAX_REC_COUNT       1
#define NDEF_MSG_BUF_SIZE   1024
#define NFC_FIELD_LED       DK_LED1
#define NFC_FIELD_LED_ERROR       DK_LED2
#define MAX_SECONDS_ELAPSED 1000
#define DEVICE_NAME CONFIG_BT_DEVICE_NAME
#define DEVICE_NAME_LEN (sizeof(DEVICE_NAME) - 1)
#define INTERVAL_MIN      0x6    /* 6 units,  7.5 ms */
#define INTERVAL_MIN_US  7500    /* 7.5 ms */

static const struct bt_data ad[] = {
    BT_DATA_BYTES(BT_DATA_FLAGS, (BT_LE_AD_GENERAL | BT_LE_AD_NO_BREDR)),
    BT_DATA_BYTES(BT_DATA_UUID16_ALL,
                  BT_UUID_16_ENCODE(BT_UUID_GATT_VAL)),
};

static uint8_t ndef_msg_buf[CONFIG_NDEF_FILE_SIZE]; /**< Buffer for NDEF file. */
static uint8_t ndef_msg_bufTwo[CONFIG_NDEF_FILE_SIZE]; /**< Buffer for NDEF file. */

enum {
    FLASH_WRITE_FINISHED,
    FLASH_BUF_PREP_STARTED,
    FLASH_BUF_PREP_FINISHED,
    FLASH_WRITE_STARTED,
};
static atomic_t op_flags;
static uint8_t flash_buf[CONFIG_NDEF_FILE_SIZE]; /**< Buffer for flash update. */
static uint8_t flash_buf_len; /**< Length of the flash buffer. */

static void flash_buffer_prepare(size_t data_length)
{   
    if (atomic_cas(&op_flags, FLASH_WRITE_FINISHED,
                   FLASH_BUF_PREP_STARTED)) {
        flash_buf_len = data_length + NFC_NDEF_FILE_NLEN_FIELD_SIZE;
        memcpy(flash_buf, ndef_msg_bufTwo, sizeof(flash_buf));

        atomic_set(&op_flags, FLASH_BUF_PREP_FINISHED);
    } else {
        printk("Flash update pending. Discarding new data...\n");
    }
}


/* Dynamic payload buffer */
static uint8_t dynamic_payload[NDEF_MSG_BUF_SIZE];

static const uint8_t en_code[] = {'e', 'n'};
static int seconds_elapsed = 0;
static int seconds_list[MAX_SECONDS_ELAPSED];
static int seconds_count = 0;
char initialPayload[NDEF_MSG_BUF_SIZE] = "payload:";

static ssize_t read_nfc_payload(struct bt_conn *conn, const struct bt_gatt_attr *attr,
                                void *buf, uint16_t len, uint16_t offset)
{
    return bt_gatt_attr_read(conn, attr, buf, len, offset, dynamic_payload, strlen(dynamic_payload));
}

/* GATT service declaration */
BT_GATT_SERVICE_DEFINE(nfc_svc,
    BT_GATT_PRIMARY_SERVICE(BT_UUID_DECLARE_16(0x1800)),
    BT_GATT_CHARACTERISTIC(BT_UUID_DECLARE_16(0x2A00),
                           BT_GATT_CHRC_READ,
                           BT_GATT_PERM_READ,
                           read_nfc_payload, NULL, NULL),
);

/**
 * @brief Function for encoding the NDEF text message.
 */
static int encode_msg(uint8_t *buffer, uint32_t *len)
{
    snprintf(dynamic_payload, sizeof(dynamic_payload), "%s", initialPayload);

    NFC_NDEF_TEXT_RECORD_DESC_DEF(nfc_en_text_rec, UTF_8, en_code, sizeof(en_code), dynamic_payload, strlen(dynamic_payload));
    NFC_NDEF_MSG_DEF(nfc_text_msg, MAX_REC_COUNT);

    int err = nfc_ndef_msg_record_add(&NFC_NDEF_MSG(nfc_text_msg), &NFC_NDEF_TEXT_RECORD_DESC(nfc_en_text_rec));
    if (err < 0) {
        return err;
    }

    err = nfc_ndef_msg_encode(&NFC_NDEF_MSG(nfc_text_msg), buffer, len);
    return err;
}

static void nfc_callback(void *context, nfc_t2t_event_t event, const uint8_t *data, size_t data_length)
{
    ARG_UNUSED(context);
    ARG_UNUSED(data);
    ARG_UNUSED(data_length);

    switch (event) {
    case NFC_T2T_EVENT_FIELD_ON:
        dk_set_led_on(NFC_FIELD_LED);
        break;

    case NFC_T2T_EVENT_FIELD_OFF:
        dk_set_led_off(NFC_FIELD_LED);
        break;

    default:
        break;
    }
}

static void ble_send_work_handler(struct k_work *work)
{
    static uint32_t len = sizeof(ndef_msg_buf);
    char temp[20];

    if (seconds_elapsed < MAX_SECONDS_ELAPSED) {
        seconds_elapsed++;
        seconds_list[seconds_count++] = seconds_elapsed;
    }

    snprintf(temp, sizeof(temp), "%d;", seconds_elapsed);
    strcat(initialPayload, temp);
    len = NDEF_MSG_BUF_SIZE;
    nfc_t2t_emulation_stop();
    if (encode_msg(ndef_msg_buf, &len) < 0) {
        dk_set_led_on(NFC_FIELD_LED_ERROR);
        printk("Cannot encode message!\n");
    } else {
        int ret = nfc_t2t_payload_set(ndef_msg_buf, len);
        if (ret < 0) {
            dk_set_led_on(NFC_FIELD_LED_ERROR);
            printk("Cannot set payload!\n");
        }
    }

    // Prepare the flash buffer with the current message
    flash_buffer_prepare(len);

    if (ndef_file_update(flash_buf, flash_buf_len) < 0) {
        printk("Cannot update NDEF file\n");
        return;
    }

    if (ndef_file_load(ndef_msg_bufTwo, sizeof(ndef_msg_bufTwo)) < 0) {
        printk("Cannot load NDEF file!\n");
        return;
    }
    nfc_t2t_emulation_start();
}

K_WORK_DEFINE(ble_send_work, ble_send_work_handler);

void timer_handler(struct k_timer *dummy)
{
    k_work_submit(&ble_send_work);
}

K_TIMER_DEFINE(ble_send_timer, timer_handler, NULL);

void nfc_callback_with_wake(void *context, nfc_t2t_event_t event, const uint8_t *data, size_t data_length)
{
    
    nfc_callback(context, event, data, data_length);

    k_timer_stop(&ble_send_timer);  // Stop the timer to wake up the system
    k_timer_start(&ble_send_timer, K_SECONDS(SLEEP_TIME), K_SECONDS(SLEEP_TIME));  // Restart the timer
}

void main(void)
{
    uint32_t len = sizeof(ndef_msg_buf);

    /* Configure LED-pins as outputs */
    if (dk_leds_init() < 0) {
        printk("Cannot init LEDs!\n");
        goto fail;
    }

    /* setup NDEF */
    if (ndef_file_setup() < 0) {
        printk("Cannot setup NDEF file!\n");
        goto fail;
    }

    /* Load NDEF message from the flash file. */
    if (ndef_file_load(ndef_msg_bufTwo, sizeof(ndef_msg_bufTwo)) < 0) {
        printk("Cannot load NDEF file!\n");
        goto fail;
    }

    /* Set up NFC */
    if (nfc_t2t_setup(nfc_callback_with_wake, NULL) < 0) {
        printk("Cannot setup NFC T2T library!\n");
        goto fail;
    }

    /* Encode message */
    if (encode_msg(ndef_msg_buf, &len) < 0) {
        printk("Cannot encode message!\n");
        goto fail;
    }

    /* Set created message as the NFC payload */
    if (nfc_t2t_payload_set(ndef_msg_buf, len) < 0) {
        printk("Cannot set payload!\n");
        goto fail;
    }

    /* Start sensing NFC field */
    if (nfc_t2t_emulation_start() < 0) {
        printk("Cannot start emulation!\n");
        goto fail;
    }

    /* Initialize the BLE Subsystem */
    int errBle = bt_enable(NULL);
    if (errBle) {
        goto fail;
    }

    /* Start advertising */
    errBle = bt_le_adv_start(BT_LE_ADV_CONN_NAME, ad, ARRAY_SIZE(ad), NULL, 0);
    if (errBle) {
        goto fail;
    }

    /* Start the timer for periodic BLE data sending */
    k_timer_start(&ble_send_timer, K_SECONDS(SLEEP_TIME), K_SECONDS(SLEEP_TIME));

    while (1) {
        // System goes to sleep until next event (timer or NFC)
        nfc_t2t_emulation_stop();
        static uint32_t len = NDEF_MSG_BUF_SIZE;
        if (encode_msg(ndef_msg_buf, &len) < 0) {
            printk("Cannot encode message!\n");
        } else {
            int ret = nfc_t2t_payload_set(ndef_msg_buf, len);
            if (ret < 0) {
                printk("Cannot set payload!\n");
            }
        }
        if (ndef_file_load(ndef_msg_bufTwo, sizeof(ndef_msg_bufTwo)) < 0) {
		printk("Cannot load NDEF file!\n");
	    }
        if (ndef_file_update(ndef_msg_bufTwo, sizeof(ndef_msg_bufTwo)) < 0 ) {
        printk("Cannot update\n");
        }
        if (ndef_file_load(ndef_msg_bufTwo, sizeof(ndef_msg_bufTwo)) < 0) {
		printk("Cannot load NDEF file!\n");
	    }
        nfc_t2t_emulation_start();
        k_sleep(K_FOREVER);
    }

fail:
#if CONFIG_REBOOT
    sys_reboot(SYS_REBOOT_COLD);
#endif
    return;
}
```

## src/ndef_file_m.c
```c
/*
 * Copyright (c) 2018 Nordic Semiconductor ASA
 *
 * SPDX-License-Identifier: LicenseRef-Nordic-5-Clause
 */

/** @file
 *
 * @ingroup nfc_writable_ndef_msg_example_ndef_file_m ndef_file_m.c
 * @{
 * @ingroup nfc_writable_ndef_msg_example
 * @brief FLASH service for the NFC writable NDEF message example.
 *
 */

#include <zephyr/kernel.h>
#include <soc.h>
#include <zephyr/device.h>
#include <string.h>
#include <zephyr/fs/nvs.h>
#include <nfc/t4t/ndef_file.h>
#include <nfc/ndef/uri_msg.h>
#include <zephyr/storage/flash_map.h>

#include "ndef_file_m.h"

#define FLASH_URL_ADDRESS_ID 1 /**< Address of URL message in FLASH */

static const uint8_t m_url[] = /**< Default NDEF message: URL "croatia.com". */
	{'p', 'a', 'y', 'l', 'o', 'a', 'd', ';'};

/* Flash partition for NVS */
#define NVS_FLASH_DEVICE FIXED_PARTITION_DEVICE(storage_partition)
/* Flash block size in bytes */
#define NVS_SECTOR_SIZE  (DT_PROP(DT_CHOSEN(zephyr_flash), erase_block_size))
#define NVS_SECTOR_COUNT 2
/* Start address of the filesystem in flash */
#define NVS_STORAGE_OFFSET FIXED_PARTITION_OFFSET(storage_partition)

static struct nvs_fs fs = {
	.sector_size = NVS_SECTOR_SIZE,
	.sector_count = NVS_SECTOR_COUNT,
	.offset = NVS_STORAGE_OFFSET,
};

int ndef_file_setup(void)
{
	int err;

	fs.flash_device = NVS_FLASH_DEVICE;
	if (fs.flash_device == NULL) {
		return -ENODEV;
	}

	err = nvs_mount(&fs);
	if (err < 0) {
		printk("Cannot initialize NVS!\n");
	}

	return err;
}

int ndef_file_update(uint8_t const *buff, uint32_t size)
{
	/* Update FLASH file with new NDEF message. */
	return nvs_write(&fs, FLASH_URL_ADDRESS_ID, buff, size);
}

/** .. include_startingpoint_ndef_file_rst */
int ndef_file_default_message(uint8_t *buff, uint32_t *size)
{
	int err;
	uint32_t ndef_size = nfc_t4t_ndef_file_msg_size_get(*size);

	/* Encode URI message into buffer. */
	err = nfc_ndef_uri_msg_encode(NFC_URI_HTTP_WWW,
				      m_url,
				      sizeof(m_url),
				      nfc_t4t_ndef_file_msg_get(buff),
				      &ndef_size);
	if (err) {
		return err;
	}

	err = nfc_t4t_ndef_file_encode(buff, &ndef_size);
	if (err) {
		return err;
	}

	*size = ndef_size;

	return 0;
}
/** .. include_endpoint_ndef_file_rst */

int ndef_restore_default(uint8_t *buff, uint32_t size)
{
	int err;

	err = ndef_file_default_message(buff, &size);
	if (err < 0) {
		printk("Cannot create default message!\n");
		return err;
	}

	/* Save record with default NDEF message. */
	err = ndef_file_update(buff, size);
	if (err < 0) {
		printk("Cannot flash NDEF message!\n");
	}
	return err;
}

int ndef_file_load(uint8_t *buff, uint32_t size)
{
	int err;

	/* If there is no record with given ID, create default message and store
	 * in FLASH. FLASH_URL_ADDRESS_ID is used to store an address, lets see
	 * if we can read it from flash, since we don't know the size read the
	 * maximum possible
	 */
	err = nvs_read(&fs, FLASH_URL_ADDRESS_ID, buff, size);
	if (err > 0) { /* Item was found, show it */
		printk("Found NDEF file record.\n");
	} else {
		printk("NDEF file record not found, creating default NDEF.\n");
		/* Create default NDEF message. */
		err = ndef_restore_default(buff, size);
	}

	return err;
}

/** @} */
```

## src/ndef_file_m.h
```c
/*
 * Copyright (c) 2018 Nordic Semiconductor ASA
 *
 * SPDX-License-Identifier: LicenseRef-Nordic-5-Clause
 */

#ifndef _NDEF_FILE_M_H__
#define _NDEF_FILE_M_H__

/** @file
 *
 * @defgroup nfc_writable_ndef_msg_example_ndef_file_m ndef_file_m.h
 * @{
 * @ingroup nfc_writable_ndef_msg_example
 * @brief FLASH service for the NFC writable NDEF message example.
 *
 */

#include <zephyr/types.h>

/**
 * @brief   Function for initializing the NVS module.
 *
 * @return 0 when module has been set up properly,
 * error code otherwise.
 */
int ndef_file_setup(void);

/**
 * @brief   Function for updating NDEF message in the flash file.
 *
 * @details NVS update operation is performed on main loop.
 *
 * @param buff Pointer to the NDEF message to be stored in flash.
 * @param size Size of NDEF message.
 *
 * @return  0 when update request has been added to the queue.
 *          Otherwise, error code.
 */
int ndef_file_update(uint8_t const *buff, uint32_t size);

/**
 * @brief Function for loading NDEF message from the flash file.
 *
 * @details If the record does not exist, the default NDEF message
 * is created and stored in flash.
 *
 * @param buff Pointer to the buffer for NDEF message.
 * @param size Size of the buffer.
 *
 * @return  0 when NDEF message has been retrieved properly. Otherwise error
 * code is returned.
 */
int ndef_file_load(uint8_t *buff, uint32_t size);

/**
 * @brief Function for creating the default NDEF message: URL "nordicsemi.com".
 *
 * @param buff Pointer to the NDEF message buffer.
 * @param size Pointer to the variable holding buffer size as input, size
 * of the created message as output.
 *
 * @return 0 if the message has been created, error code otherwise.
 */
int ndef_file_default_message(uint8_t *buff, uint32_t *size);

/**
 * @brief Function for creating and storing the default NDEF message:
 * URL "nordicsemi.com".
 *
 * @param buff Pointer to the NDEF message buffer.
 * @param size Pointer to the variable holding buffer size as input, size
 * of the created message as output.
 *
 * @return 0 if the message has been created, error code otherwise.
 */
int ndef_restore_default(uint8_t *buff, uint32_t size);

/** @} */

#endif /* _NDEF_FILE_M_H__ */
```
