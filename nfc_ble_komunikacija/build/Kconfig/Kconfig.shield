## nfc_ble_komunikacija/build/Kconfig/Kconfig.sysbuild.modules
```kconfig
menu "nrf (C:/ncs/v2.5.3/nrf)"
osource "C:/ncs/v2.5.3/nrf/sysbuild/Kconfig.sysbuild"
config ZEPHYR_NRF_MODULE
	bool
	default y
endmenu
```
